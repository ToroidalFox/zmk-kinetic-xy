## Kconfig
```kconfig
config ZMK_INPUT_PROCESSOR_KINETIC_XY
	bool "Kinetic XY"
	default y
	depends on ZMK_POINTING
	depends on !ZMK_SPLIT || ZMK_SPLIT_ROLE_CENTRAL

config ZMK_INPUT_PROCESSOR_KINETIC_XY_TOGGLE
	bool "Kinetic XY Toggle"
	default y
	depends on ZMK_INPUT_PROCESSOR_KINETIC_XY
	help
	  Enable the ability to toggle kinetic XY processing on a
	  per-slot basis.

config ZMK_INPUT_PROCESSOR_KINETIC_XY_TOGGLE_STATES
	int "Kinetic XY Toggle States"
	default 4
	depends on ZMK_INPUT_PROCESSOR_KINETIC_XY_TOGGLE
	help
	  Number of slots to set toggle states.
```

## dts/bindings/behaviors/zmk,kinetic-xy-toggle.yaml
```yaml
description: Toggle kinetic XY processing for a given slot

compatible: "zmk,behavior-kinetic-xy-toggle"

properties:
  slot:
    type: int
    required: true
    description: |
      Kinetic XY slot index to toggle (0-7).
```

## dts/bindings/input_processors/zmk,input-processor-kinetic-xy.yaml
```yaml
description: Kinetic XY input processor with per-instance configuration

compatible: "zmk,input-processor-kinetic-xy"

include: ip_zero_param.yaml

properties:
  toggle-slot:
    type: int
    required: true
    description: |
      Slot index for this kinetic XY instance. Used to identify
      the instance for toggling.

  map-as:
    type: string
    required: true
    description:
      Whether to map xy events as cursor movement or scroll input.
    enum:
      - "cursor"
      - "scroll"

  invert-x:
    type: boolean
    description: Invert X.
  invert-y:
    type: boolean
    description: Invert Y.
  swap-xy:
    type: boolean
    description: Swap X and Y.

  event-delay:
    type: int
    required: true
    description: |
      Initial delay in milliseconds after an input event before
      kinetic movement begins. Prevents simulated events from
      clashing with real input events. Should be higher than
      report rate of the device.

  event-interval:
    type: int
    required: true
    description: |
      Interval in milliseconds between kinetic simulation ticks.
      80% value of this also sets minimum delta time between events
      to iron out irregular event timings.
      Try to find the exact update rate. Example link of finding it:
      https://www.mouser.com/pdfDocs/InterfaceSPIandI2C.pdf

  decay-rate:
    type: int
    required: true
    description: |
      Decay rate value per `event-interval` in per mille.
      Should be 0(no friction) to 1000(infinity friction).

  clamp-threshold:
    type: int
    required: true
    default: 1
    description: |
      Velocity threshold below which kinetic movement stops.

  trigger-threshold:
    type: int
    required: true
    description:
      Minimum speed needed to start kinetic movement.
```
